## components/led_controller/Kconfig
```kconfig
menu "LED Controller"
config LED_CONTROLLER_GPIO
    int "WS2812 data GPIO number"
    default 48
    help
        GPIO pin connected to the WS2812 DIN line.
endmenu
```

## sdkconfig.defaults
```kconfig
CONFIG_PARTITION_TABLE_CUSTOM=y
CONFIG_PARTITION_TABLE_CUSTOM_FILENAME="partitions.csv"
CONFIG_ESPTOOLPY_FLASHSIZE_4MB=y
CONFIG_HTTPD_WS_SUPPORT=y
CONFIG_ESP_WIFI_SOFTAP_SUPPORT=y
CONFIG_ESP_SYSTEM_EVENT_TASK_STACK_SIZE=6144
CONFIG_LWIP_MAX_SOCKETS=16
```
